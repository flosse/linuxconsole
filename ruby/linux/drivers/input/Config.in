## ruby/linux/drivers/video/Config.in
```kconfig
#
# Video configuration
#

mainmenu_option next_comment
comment 'Video '

#
# Video card configuration
#
bool 'Support for frame buffer devices (EXPERIMENTAL)' CONFIG_FB

if [ "$CONFIG_FB" = "y" ]; then
   mainmenu_option next_comment
   comment 'Frame-buffer support'

   if [ "$CONFIG_EXPERIMENTAL" = "y" ]; then
      if [ "$CONFIG_PCI" = "y" ]; then
         tristate '  nVidia Riva support (EXPERIMENTAL)' CONFIG_FB_RIVA
      fi
      if [ "$CONFIG_AMIGA" = "y" -o "$CONFIG_PCI" = "y" ]; then
         tristate '  Cirrus Logic support (EXPERIMENTAL)' CONFIG_FB_CLGEN
         tristate '  Permedia2 support (EXPERIMENTAL)' CONFIG_FB_PM2
         if [ "$CONFIG_FB_PM2" = "y" ]; then
            if [ "$CONFIG_PCI" = "y" ]; then
               bool '    enable FIFO disconnect feature' CONFIG_FB_PM2_FIFO_DISCONNECT
               bool '    generic Permedia2 PCI board support' CONFIG_FB_PM2_PCI
            fi
            if [ "$CONFIG_AMIGA" = "y" ]; then
               bool '    Phase5 CVisionPPC/BVisionPPC support' CONFIG_FB_PM2_CVPPC
            fi
         fi
      fi
   fi
   dep_bool '  Acorn VIDC support' CONFIG_FB_ACORN $CONFIG_ARCH_ACORN
   dep_bool '  CLPS711X LCD support' CONFIG_FB_CLPS711X $CONFIG_ARCH_CLPS711X	
   dep_tristate '  Cyber2000 support' CONFIG_FB_CYBER2000 $CONFIG_PCI
   dep_bool '  SA-1100 LCD support' CONFIG_FB_SA1100 $CONFIG_ARCH_SA1100
   dep_bool '  Anakin LCD support' CONFIG_FB_ANAKIN $CONFIG_ARCH_ANAKIN
   if [ "$CONFIG_APOLLO" = "y" ]; then
      define_bool CONFIG_FB_APOLLO y
   fi
   if [ "$CONFIG_Q40" = "y" ]; then
      define_bool CONFIG_FB_Q40 y
   fi  
   if [ "$CONFIG_AMIGA" = "y" ]; then
      tristate '  Amiga native chipset support' CONFIG_FB_AMIGA
      if [ "$CONFIG_FB_AMIGA" != "n" ]; then
         bool '    Amiga OCS chipset support' CONFIG_FB_AMIGA_OCS
         bool '    Amiga ECS chipset support' CONFIG_FB_AMIGA_ECS
         bool '    Amiga AGA chipset support' CONFIG_FB_AMIGA_AGA
      fi
   fi
   if [ "$CONFIG_ZORRO" = "y" ]; then
      tristate '  Amiga CyberVision support' CONFIG_FB_CYBER
      if [ "$CONFIG_EXPERIMENTAL" = "y" ]; then
         bool '  Amiga CyberVision3D support (EXPERIMENTAL)' CONFIG_FB_VIRGE
         tristate '  Amiga RetinaZ3 support (EXPERIMENTAL)' CONFIG_FB_RETINAZ3
         bool '  Amiga FrameMaster II/Rainbow II support (EXPERIMENTAL)' CONFIG_FB_FM2
      fi
   fi
   if [ "$CONFIG_ATARI" = "y" ]; then
      bool '  Atari native chipset support' CONFIG_FB_ATARI
      tristate '  ATI Mach64 display support' CONFIG_FB_ATY
      if [ "$CONFIG_FB_ATY" != "n" ]; then
         define_bool CONFIG_FB_ATY_GX y
      fi
   fi
   if [ "$CONFIG_PPC" = "y" ]; then
      bool 'Backward compatibility mode for Xpmac' CONFIG_FB_COMPAT_XPMAC
      bool '  Open Firmware frame buffer device support' CONFIG_FB_OF
      bool '    Apple "control" display support' CONFIG_FB_CONTROL
      bool '    Apple "platinum" display support' CONFIG_FB_PLATINUM
      bool '    Apple "valkyrie" display support' CONFIG_FB_VALKYRIE
      bool '    IMS Twin Turbo display support' CONFIG_FB_IMSTT
      bool '    Chips 65550 display support' CONFIG_FB_CT65550
      bool '    S3 Trio display support' CONFIG_FB_S3TRIO
      tristate '  VGA 16-color graphics console' CONFIG_FB_VGA16
   fi
   if [ "$CONFIG_MAC" = "y" ]; then
      define_bool CONFIG_FB_MAC y
      bool '  Apple "valkyrie" display support' CONFIG_FB_VALKYRIE
#     bool '  Apple DAFB display support' CONFIG_FB_DAFB
   fi
   if [ "$CONFIG_HP300" = "y" ]; then
      define_bool CONFIG_FB_HP300 y
   fi
   if [ "$ARCH" = "alpha" ]; then
      tristate '  TGA framebuffer support' CONFIG_FB_TGA
   fi
   if [ "$ARCH" = "mips" -a "$CONFIG_CPU_VR41XX" = "y" ]; then
      tristate '  Simple frame buffer display support' CONFIG_FB_SIMPLE
      tristate '  Epson SED1345 Color Graphics LCD/CRT Controller' CONFIG_FB_SED1345
      tristate '  Toshiba R3912 / Philips PR31700 LCD Controller' CONFIG_FB_R3912
      if [ "$CONFIG_VTECH_HELIO" = "y" ]; then
         bool '    Force 1bpp mode' CONFIG_FB_R3912_FORCE_MONO
      fi
   fi
   if [ "$ARCH" = "i386" ]; then
      bool '  VESA VGA graphics console' CONFIG_FB_VESA
      tristate '  VGA 16-color graphics console' CONFIG_FB_VGA16
      tristate '  Hercules mono graphics console ' CONFIG_FB_HGA
      define_bool CONFIG_VIDEO_SELECT y
   fi
   if [ "$CONFIG_VISWS" = "y" ]; then
      tristate '  SGI Visual Workstation framebuffer support' CONFIG_FB_SGIVW
      define_bool CONFIG_BUS_I2C y
   fi
   if [ "$CONFIG_SUN3" = "y" -o "$CONFIG_SUN3X" = "y" ]; then
      bool '  Sun3 framebuffer support' CONFIG_FB_SUN3
      if [ "$CONFIG_FB_SUN3" != "n" ]; then
         bool '  BWtwo support' CONFIG_FB_BWTWO
         bool '  CGsix (GX,TurboGX) support' CONFIG_FB_CGSIX
      fi
   fi
   bool '  Epson 1355 framebuffer support' CONFIG_FB_E1355
   if [ "$CONFIG_FB_E1355" = "y" ]; then
      hex '    Register Base Address' CONFIG_E1355_REG_BASE a8000000
      hex '    Framebuffer Base Address' CONFIG_E1355_FB_BASE a8200000
   fi
   if [ "$CONFIG_SH_DREAMCAST" = "y" ]; then
      tristate '  Dreamcast Frame Buffer support' CONFIG_FB_DC
   fi              	
   if [ "$CONFIG_PCI" != "n" ]; then
      tristate '  Matrox acceleration (EXPERIMENTAL)' CONFIG_FB_MATROX
      if [ "$CONFIG_FB_MATROX" != "n" ]; then
         bool '    Millennium I/II support' CONFIG_FB_MATROX_MILLENIUM
         bool '    Mystique support' CONFIG_FB_MATROX_MYSTIQUE
         bool '    G100/G200/G400/G450 support' CONFIG_FB_MATROX_G100
         if [ "$CONFIG_I2C" != "n" ]; then
            dep_tristate '      Matrox I2C support' CONFIG_FB_MATROX_I2C $CONFIG_FB_MATROX $CONFIG_I2C_ALGOBIT
            if [ "$CONFIG_FB_MATROX_G100" = "y" ]; then
               dep_tristate '      G400 second head support' CONFIG_FB_MATROX_MAVEN $CONFIG_FB_MATROX_I2C
            fi
         fi
         dep_tristate '     G450 second head support' CONFIG_FB_MATROX_G450 $CONFIG_FB_MATROX_G100
         bool '    Multihead support' CONFIG_FB_MATROX_MULTIHEAD
      fi
      tristate '  ATI Mach64 display support (EXPERIMENTAL)' CONFIG_FB_ATY
      if [ "$CONFIG_FB_ATY" != "n" ]; then
         bool '    Mach64 GX support (EXPERIMENTAL)' CONFIG_FB_ATY_GX
         bool '    Mach64 CT/VT/GT/LT (incl. 3D RAGE) support' CONFIG_FB_ATY_CT
      fi
      tristate '  ATI Rage 128 display support (EXPERIMENTAL)' CONFIG_FB_ATY128
      tristate '  3Dfx acceleration support' CONFIG_FB_TDFX 
      if [ "$CONFIG_FB_TDFX" != "n" ]; then		
         bool '    3Dfx Banshee/Voodoo3 display support (EXPERIMENTAL)' CONFIG_FB_3DFX
      	 bool '    Voodoo 1 display support (EXPERIMENTAL)' CONFIG_FB_SST	
      fi	
      tristate '  SIS 630/540 display support (EXPERIMENTAL)' CONFIG_FB_SIS
   fi
   if [ "$ARCH" = "sparc" -o "$ARCH" = "sparc64" ]; then
      bool '  SBUS and UPA framebuffers' CONFIG_FB_SBUS
      if [ "$CONFIG_FB_SBUS" != "n" ]; then
         if [ "$ARCH" = "sparc64" ]; then
            bool '    Creator/Creator3D support' CONFIG_FB_CREATOR
         fi
         bool '    CGsix (GX,TurboGX) support' CONFIG_FB_CGSIX
         bool '    BWtwo support' CONFIG_FB_BWTWO
         bool '    CGthree support' CONFIG_FB_CGTHREE
         if [ "$ARCH" = "sparc" ]; then
            bool '    TCX (SS4/SS5 only) support' CONFIG_FB_TCX
            bool '    CGfourteen (SX) support' CONFIG_FB_CGFOURTEEN
            bool '    P9100 (Sparcbook 3 only) support' CONFIG_FB_P9100
         fi
         bool '    Leo (ZX) support' CONFIG_FB_LEO
      fi
   fi
   if [ "$ARCH" = "sparc" ]; then
      if [ "$CONFIG_PCI" != "n" ]; then
         bool '  PCI framebuffers' CONFIG_FB_PCI
         if [ "$CONFIG_FB_PCI" != "n" ]; then
            bool '    IGA 168x display support' CONFIG_FB_IGA
         fi
      fi
   fi
   if [ "$ARCH" = "sparc64" ]; then
      if [ "$CONFIG_PCI" != "n" ]; then
         bool '  PCI framebuffers' CONFIG_FB_PCI
         if [ "$CONFIG_FB_PCI" != "n" ]; then
            tristate '    ATI Mach64 display support' CONFIG_FB_ATY
	    if [ "$CONFIG_FB_ATY" != "n" ]; then
               define_bool CONFIG_FB_ATY_CT y
            fi
         fi
      fi
   fi
   if [ "$CONFIG_HD64461" = "y" ]; then
      tristate '  HD64461 Frame Buffer support' CONFIG_FB_HIT
   fi
   if [ "$CONFIG_EXPERIMENTAL" = "y" ]; then
      tristate '  Virtual Frame Buffer support (ONLY FOR TESTING!)' CONFIG_FB_VIRTUAL
   fi
   endmenu
fi

#
# Console Configuration
#
if [ "$CONFIG_VT" = "y" ]; then
comment 'Console drivers'
# where can't vga exist? m68k mip64 sparc(64)
   if [ "$ARCH" = "sparc" -o "$ARCH" = "sparc64" ]; then
      bool 'PROM console' CONFIG_PROM_CONSOLE
   fi
   if [ "$CONFIG_SGI_IP22" = "y" ]; then
      tristate 'SGI Newport Console support' CONFIG_SGI_NEWPORT_CONSOLE
   fi
   if [ "$CONFIG_PARISC" = "y" ]; then
      #bool 'IODC console' CONFIG_IODC_CONSOLE
      bool 'STI console' CONFIG_STI_CONSOLE
   fi
   bool 'VGA text console' CONFIG_VGA_CONSOLE
   #  if [ "$CONFIG_PCI" = "y" -a "$CONFIG_VGA_CONSOLE" = "y" ]; then
   #    bool '   Allow VGA on any bus?' CONFIG_VGA_HOSE
   #    if [ "$CONFIG_VGA_HOSE" = "y" ]; then
   #      define_bool CONFIG_DUMMY_CONSOLE y
   #    fi
   #  fi

   if [ "$ARCH" = "i386" -o "$ARCH" = "sh" ]; then
      bool 'Video mode selection support' CONFIG_VIDEO_SELECT
      tristate 'MDA text console (EXPERIMENTAL)' CONFIG_MDA_CONSOLE
   fi
   #bool 'Dummy console support' CONFIG_DUMMY_CONSOLE	
   if [ "$CONFIG_PCI" = "y" ]; then
      tristate 'NVIDIA hardware text console' CONFIG_NVIDIA_CONSOLE
   fi
   if [ "$CONFIG_FB" = "y" ]; then
      bool 'Support for frame buffer console' CONFIG_FRAMEBUFFER_CONSOLE
      if [ "$CONFIG_FRAMEBUFFER_CONSOLE" = "y" ]; then
         define_bool CONFIG_PCI_CONSOLE y
      fi
   fi
   if [ "$CONFIG_FRAMEBUFFER_CONSOLE" != "n" -o "$CONFIG_NEWPORT_CONSOLE" != "n" -o "$CONFIG_VGA_CONSOLE" = "y" ]; then
      define_bool CONFIG_FONTS y	
      source drivers/video/fonts/Config.in
   fi
fi
endmenu
```
